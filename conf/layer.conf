## conf/layer.conf
```bitbake
# We have a conf and classes directory, add to BBPATH
BBPATH .= ":${LAYERDIR}"

# We have recipes-* directories, add to BBFILES
BBFILES += "${LAYERDIR}/recipes-*/*/*.bb \
            ${LAYERDIR}/recipes-*/*/*.bbappend"

BBFILE_COLLECTIONS += "meta-linht-software"
BBFILE_PATTERN_meta-linht-software = "^${LAYERDIR}/"
BBFILE_PRIORITY_meta-linht-software = "6"

LAYERDEPENDS_meta-linht-software = "core"
LAYERSERIES_COMPAT_meta-linht-software = "scarthgap"
```
